## firmware/main/Kconfig.projbuild
```kconfig
menu "Water logger"
    config LOGGER_BUILDING_ID
        string "Building identifier"
        default "building_1"

    config LOGGER_ROOMS
        string "Room meter addresses (electric:water, e.g. 1:2,3:4)"
        default ""
        help
            Modbus addresses of each room's electric and water meter, one electric:water
            pair per room, rooms separated by commas. Room numbers follow list order.
            Example: 1:2,3:4 = room 1 has meters 1 and 2, room 2 has meters 3 and 4.
            Addresses must be numbers 1-247, all different; at most 16 rooms.

    config LOGGER_UART_PORT
        int "RS485 UART port"
        range 1 2
        default 2

    config LOGGER_TX_GPIO
        int "RS485 TX GPIO (ESP32 -> transceiver DI)"
        range 0 48
        default 16
        help
            GPIO16 on the iMaker ESP32 board with built-in RS485.

    config LOGGER_RX_GPIO
        int "RS485 RX GPIO (transceiver RO -> ESP32)"
        range 0 48
        default 17
        help
            GPIO17 on the iMaker ESP32 board with built-in RS485.

    config LOGGER_RTS_GPIO
        int "RS485 RTS/DE GPIO (-1 = transceiver switches direction itself)"
        range -1 48
        default -1
        help
            Leave -1 for auto-direction transceivers such as the one on the iMaker board.
            Set a GPIO when DE/RE must be driven by the ESP32; the UART then runs in
            RS485 half-duplex mode and drives it as RTS.

    config LOGGER_BAUD
        int "RS485 baud rate"
        range 1200 115200
        default 9600
        help
            DDSU666 meters run at 2400, 4800 or 9600 bps (BAud register); the test meter uses 9600.

    choice LOGGER_PARITY
        prompt "RS485 parity"
        default LOGGER_PARITY_NONE
        config LOGGER_PARITY_NONE
            bool "None"
        config LOGGER_PARITY_EVEN
            bool "Even"
        config LOGGER_PARITY_ODD
            bool "Odd"
    endchoice

    choice LOGGER_STOP_BITS
        prompt "RS485 stop bits"
        default LOGGER_STOP_BITS_ONE
        config LOGGER_STOP_BITS_ONE
            bool "One"
        config LOGGER_STOP_BITS_TWO
            bool "Two"
    endchoice

    config LOGGER_TIMEOUT_MS
        int "Modbus response timeout (ms)"
        range 100 10000
        default 1000

    config LOGGER_RETRIES
        int "Modbus retries"
        range 0 5
        default 2

    config LOGGER_POLL_MS
        int "Poll interval (ms)"
        range 1000 3600000
        default 10000

    config LOGGER_MQTT_URI
        string "MQTT broker URI (empty disables MQTT)"
        default ""

    config LOGGER_WIFI_SSID
        string "Wi-Fi SSID"
        default ""

    config LOGGER_WIFI_PASSWORD
        string "Wi-Fi password"
        default ""

    config LOGGER_MQTT_TOPIC
        string "MQTT telemetry topic"
        default "water-logger/readings"

    config LOGGER_MQTT_QOS
        int "MQTT QoS"
        range 0 2
        default 1

    config LOGGER_MQTT_USER
        string "MQTT username"
        default ""

    config LOGGER_MQTT_PASSWORD
        string "MQTT password"
        default ""

    config LOGGER_MQTT_RECONNECT_MS
        int "MQTT reconnect interval (ms)"
        range 1000 600000
        default 10000

    config LOGGER_DEVICE_ID
        string "Device identifier (empty = ESP32_ + last 3 MAC bytes)"
        default ""
        help
            Names this logger in records, heartbeats, the MQTT client ID and the status
            topic; must be unique per broker. Empty uses ESP32_XXXXXX from the Wi-Fi MAC
            address. At most 32 characters.

    config LOGGER_MQTT_HEARTBEAT_TOPIC
        string "MQTT heartbeat topic (empty disables heartbeats)"
        default "water-logger/heartbeat"

    config LOGGER_MQTT_STATUS_TOPIC
        string "MQTT online/offline status topic prefix (empty disables)"
        default "water-logger/status"
        help
            On connect the logger publishes {"device_id":...,"online":true} retained to
            <prefix>/<device id>; when the connection is lost the broker publishes
            {"online":false} there (MQTT last will, after about 45 s).

    config LOGGER_HEARTBEAT_S
        int "Heartbeat interval (s)"
        range 10 3600
        default 60

    config LOGGER_QUEUE_CAPACITY
        int "Offline record queue capacity (records)"
        range 10 5000
        default 2000
        help
            Every cycle's record is stored in the "queue" flash partition and removed only
            after the broker acknowledged it (QoS 1/2). When the queue is full the oldest
            record is overwritten. Changing this value discards the records still queued.

    config LOGGER_SNTP_SERVER
        string "SNTP server (empty = records carry ts null)"
        default "pool.ntp.org"

    menu "Status LEDs"
        config LOGGER_LED_SYSTEM_GPIO
            int "System LED GPIO (-1 = none)"
            range -1 33
            default 5
            help
                On while starting, double blink every 2 s while read cycles keep completing,
                fast blink on a fault (bad configuration, RS485 init failed, main loop stuck).

        config LOGGER_LED_NETWORK_GPIO
            int "Network LED GPIO (-1 = none)"
            range -1 33
            default 12
            help
                Off without a broker, slow blink while joining Wi-Fi, fast blink while the
                broker is unreachable, on when connected (dark briefly per acknowledged record).
                GPIO12 selects the flash voltage at reset: the LED must not pull it high then
                (an LED from the pin to GND is fine).

        config LOGGER_LED_METER_GPIO
            int "Meter LED GPIO (-1 = none)"
            range -1 33
            default 13
            help
                Short flash after each cycle in which every meter answered, slow blink when
                some failed, on when all failed.

        config LOGGER_LED_ACTIVE_LOW
            bool "LEDs light when the pin is low"
            default n
    endmenu

    config LOGGER_FAKE_ELECTRIC
        bool "Send simulated electric readings (test without meters)"
        default n
        help
            Fills every room's electric reading with plausible made-up values
            (about 230 V, a varying current, power and a rising energy total)
            so Wi-Fi and MQTT can be tested without RS485 meters. The readings
            are sent with status "simulated". Never enable on a deployed logger.
endmenu
```

## tools/ddsu666/firmware/main/Kconfig.projbuild
```kconfig
menu "RS485 bridge (DDSU666 tool)"
    config BRIDGE_UART_PORT
        int "RS485 UART port"
        range 1 2
        default 2
        help
            UART0 stays the USB link to the PC.

    config BRIDGE_TX_GPIO
        int "RS485 TX GPIO (ESP32 -> transceiver DI)"
        range 0 48
        default 16

    config BRIDGE_RX_GPIO
        int "RS485 RX GPIO (transceiver RO -> ESP32)"
        range 0 48
        default 17

    config BRIDGE_DE_GPIO
        int "RS485 DE/RE GPIO (-1 = transceiver switches direction itself)"
        range -1 48
        default -1
        help
            Leave -1 for boards with an auto-direction RS485 transceiver.
            Set a GPIO when DE/RE must be driven by the ESP32; the UART then
            runs in RS485 half-duplex mode and drives it as RTS.

    config BRIDGE_DEFAULT_BAUD
        int "RS485 baud rate after boot"
        range 1200 115200
        default 9600
        help
            The PC tool sets the baud rate and frame format itself after connecting.
endmenu
```
